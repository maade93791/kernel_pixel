## private/google-modules/soc/gs/drivers/dma-buf/heaps/Kconfig
```kconfig
# SPDX-License-Identifier: GPL-2.0

config DMABUF_HEAPS_DEFERRED_FREE
	tristate

config DMABUF_HEAPS_PAGE_POOL
	tristate

source "$(KCONFIG_SOC_GS_PREFIX)drivers/dma-buf/heaps/samsung/Kconfig"
```

## private/google-modules/soc/gs/drivers/soc/google/gcma/Kconfig
```kconfig
# SPDX-License-Identifier: GPL-2.0
#
config GCMA_VENDOR
	tristate "Pixel GCMA accounting and diagnostics"
	depends on GCMA && GCMA_SYSFS && ANDROID_VENDOR_HOOKS
	help
	  Preserve Pixel memory accounting, allocation latency statistics and
	  diagnostic interfaces while using the Android common GCMA allocator.
```
